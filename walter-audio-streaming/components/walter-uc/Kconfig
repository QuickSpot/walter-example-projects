## walter-audio-streaming/components/walter-uc/Kconfig
```kconfig
menu "Walter-UC"
    config ESP_MODEM_URC_HANDLER_DEFAULT
        bool
        default y
        select ESP_MODEM_URC_HANDLER

    config ESP_LWIP_PPP_HANDLER_DEFAULT
        bool
        default y
        select LWIP_PPP_SUPPORT
endmenu
```

## walter-audio-streaming/components/walter-uc/examples/bluecherry/sdkconfig.defaults
```kconfig
CONFIG_ESP_TLS_USING_MBEDTLS=y
CONFIG_MBEDTLS_SSL_DTLS_CONNECTION_ID=y
CONFIG_MBEDTLS_SSL_PROTO_DTLS=y
CONFIG_ESP_MAIN_TASK_STACK_SIZE=8192
CONFIG_PARTITION_TABLE_TWO_OTA=y
CONFIG_ESPTOOLPY_FLASHSIZE_4MB=y
```
