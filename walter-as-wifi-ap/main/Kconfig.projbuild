## walter-as-wifi-ap/main/Kconfig.projbuild
```kconfig
menu "Example Configuration"

    config ESP_WIFI_SSID
        string "WiFi SSID"
        default "myssid"
        help
            SSID (network name) for the example to connect to.

    config ESP_WIFI_PASSWORD
        string "WiFi Password"
        default "mypassword"
        help
            WiFi password (WPA or WPA2) for the example to use.

    config ESP_WIFI_CHANNEL
        int "WiFi Channel"
        range 1 13
        default 1
        help
            WiFi channel (network channel) for the example to use.

    config ESP_MAX_STA_CONN
        int "Maximal STA connections"
        default 4
        help
            Max number of the STA connects to AP.

    config EXAMPLE_MODEM_PPP_APN
        string "Set MODEM APN"
        default ""
        help
            Set APN (Access Point Name), a logical name to choose data network

    config EXAMPLE_NEED_SIM_PIN
        bool "SIM PIN needed"
        default n
        help
            Enable to set SIM PIN before starting the example

    config EXAMPLE_SIM_PIN
        string "Set SIM PIN"
        default "1234"
        depends on EXAMPLE_NEED_SIM_PIN
        help
            Pin to unlock the SIM

    config EXAMPLE_MODEM_TX_PIN
        int "Modem UART TX Pin"
        default 48
        help
            GPIO number for modem UART TX

    config EXAMPLE_MODEM_RX_PIN
        int "Modem UART RX Pin"
        default 14
        help
            GPIO number for modem UART RX

    config EXAMPLE_MODEM_CTS_PIN
        int "Modem UART CTS Pin"
        default 47
        help
            GPIO number for modem UART CTS

    config EXAMPLE_MODEM_RTS_PIN
        int "Modem UART RTS Pin"
        default 21
        help
            GPIO number for modem UART RTS

    config EXAMPLE_MODEM_RESET_PIN
        int "Modem UART RESET Pin"
        default 45
        help
            GPIO number for modem UART RESET

endmenu
```
